#include <FastLED.h>
#include <fix_fft.h>

/* fastled */
CRGBPalette16 currentPalette;
TBlendType    currentBlending;

#define LED_PIN     5
#define BRIGHTNESS  64
#define NUM_LEDS    144
#define LED_TYPE    WS2812B
#define COLOR_ORDER GRB
CRGB leds[NUM_LEDS];
void flsetup() {
  FastLED.addLeds<LED_TYPE, LED_PIN, COLOR_ORDER>(leds, NUM_LEDS).setCorrection( TypicalLEDStrip );
  //FastLED.setBrightness(  BRIGHTNESS );
  currentPalette = RainbowColors_p;
  currentBlending = LINEARBLEND;
}

/* /fastled */
const byte adcPin = 1;  // A0

const int BITS = 7;
const int MAX_RESULTS = 1 << BITS;

typedef int16_t VALTYPE;
#define MVTYPE 32767

volatile VALTYPE results [MAX_RESULTS];
volatile int8_t* results8 = (volatile signed char*)results;
volatile int8_t* ims8 = (volatile signed char*)results8+MAX_RESULTS;
uint8_t temporal[MAX_RESULTS/2];
volatile int resultNumber;
// http://garretlab.web.fc2.com/en/arduino/inside/hardware/arduino/avr/cores/arduino/wiring_analog.c/analogRead.html
// 32 prescale
#define D_ADSRA (bit (ADEN) | bit (ADIE) | bit (ADIF)| bit (ADPS2) | bit (ADATE))

void setup ()
  {
    //Serial.begin(115200);
    //Serial.println();
  flsetup();

  // reset Timer 1
  TCCR1A = 0;
  TCCR1B = 0;
  TCNT1 = 0;
  TCCR1B = bit (CS11) | bit (WGM12);  // CTC, prescaler of 8
  TIMSK1 = bit (OCIE1B);
  OCR1A = 39;    
  OCR1B = 39;   // 20 uS - sampling frequency 50 kHz

  //ADCSRA =  bit (ADEN) | bit (ADIE) | bit (ADIF);   // turn ADC on, want interrupt on completion
  //ADCSRA |= bit (ADPS2);  // Prescaler of 16
//  ADCSRA |= (1 << ADPS1) | (1 << ADPS0);    // 8 prescaler for 153.8 KHz
  ADMUX = bit (REFS0) | (adcPin & 7);
  ADCSRB = bit (ADTS0) | bit (ADTS2);  // Timer/Counter1 Compare Match B
  //ADCSRA |= bit (ADATE);   // turn on automatic triggering
  ADCSRA = D_ADSRA;
}

// ADC complete ISR
ISR (ADC_vect)
{
    results[resultNumber] = ADC;
    resultNumber++; 
    if(resultNumber == MAX_RESULTS)
    {
      ADCSRA = 0;  // turn off ADC
    }
} 

EMPTY_INTERRUPT (TIMER1_COMPB_vect);

const float hanning128[128] PROGMEM = {0,0.0006022718974137975,0.0024076366639015356,0.005411745017609493,0.009607359798384785,0.014984373402728013,0.021529832133895588,0.029227967408489597,0.03806023374435663,0.04800535343827833,0.059039367825822475,0.07113569499986394,0.08426519384872738,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0.0024076366639015356,0.0006022718974137975};
const float hanning256[256] PROGMEM = {0,0.00015059065189787502,0.0006022718974137975,0.0013547716606548965,0.0024076366639015356,0.0037602327006450165,0.005411745017609493,0.007361178805529389,0.009607359798384785,0.012148934980735715,0.014984373402728013,0.01811196710228008,0.021529832133895588,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0.0006022718974137975,0.00015059065189787502};

void loop () {

  while (resultNumber < MAX_RESULTS)
    { }
  VALTYPE mv = 0;
  /*for(int i=0;i<MAX_RESULTS;++i) {
    if (results[i] > mv) mv = results[i];
  }
  mv = MVTYPE/mv;*/
  results[1] = results[2];
  results[0] = results[1];
  mv = 1;
  long sum = 0;
  for(int i=0;i<MAX_RESULTS-1;++i) {
    //results[i] *= mv * pgm_read_float(&hanning[i]);
    sum += results[i];
    /*if (results[i]>mv) {
      mv = results[i];
    }*/
  }
  sum /= MAX_RESULTS;
  //mv-=sum;
  //mv=255/mv-2;
  mv = 10;
  //Serial.println(mv);
  for(int i=0;i<MAX_RESULTS-1;++i) {
    results[i]-=sum;
    results[i] *= mv * pgm_read_float(&hanning128[i]);
    results8[i] = results[i];
  }
  for(int i=0;i<MAX_RESULTS-1;++i) {
    ims8[i] = 0;
  }
  fix_fft(results8, ims8, BITS, 0);

  //FillLEDsFromPaletteColors( startIndex);
  
  //FastLED.delay(1000 / UPDATES_PER_SECOND);
  
  uint8_t brightness = 255;
  int bound = 10;  
  int ubound = 250;
  int offs = 2;  
  int xscale = 4;
  int limit = NUM_LEDS;
  int vres = 1;
  for(int i=offs;i<MAX_RESULTS/2;++i) {
    float rval = sqrt(results8[i]*results8[i]+ims8[i]*ims8[i]);
    rval = 20 * log10(rval) * 6;
    rval/=vres;
    rval=round(rval);
    rval *= vres;
    if (rval < bound) rval = bound;
    if (rval > ubound) rval = ubound;
    CRGB color = ColorFromPalette( currentPalette, rval, rval, currentBlending);
    uint8_t base = (i-offs)*xscale;
    for(int t = 0;t<xscale&&base+t<limit;++t) {
      //CRGB color = ColorFromPalette( currentPalette, base+t, rval, currentBlending);
      leds[base+t] = color;
    }
  }

  FastLED.show();
  //FastLED.delay(1000/50);
  /*for(int i=1;i<MAX_RESULTS/2-1;++i) {
    Serial.println(results[i]);
  }*/

  resultNumber = 0;
  ADCSRA =  D_ADSRA; 
}
